## configs/hjdskes_rpi3_defconfig
```kconfig
# Target
BR2_arm=y
BR2_cortex_a53=y
BR2_ARM_FPU_NEON_VFPV4=y

# Buildroot settings
BR2_DL_DIR="$(HOME)/.buildroot"
BR2_CCACHE=y

# Toolchain
BR2_TOOLCHAIN_BUILDROOT_CXX=y
BR2_TOOLCHAIN_BUILDROOT_GLIBC=y
BR2_BINUTILS_VERSION_2_31_X=y
BR2_GCC_VERSION_8_X=y

# Device configuration
BR2_TARGET_GENERIC_HOSTNAME="rpi3"
BR2_TARGET_GENERIC_ISSUE="Welcome to Rpi3"
BR2_TARGET_GENERIC_ROOT_PASSWD="root"
BR2_ROOTFS_USERS_TABLES="board/hjdskes/rpi3/usertable.txt"
BR2_TARGET_GENERIC_GETTY_PORT="tty1"
BR2_TARGET_GENERIC_REMOUNT_ROOTFS_RW=n
BR2_TARGET_TZ_INFO=y
BR2_TARGET_LOCALTIME="Europe/Stockholm"
BR2_SYSTEM_BIN_SH_BASH=y
BR2_INIT_SYSTEMD=y

# Linux kernel
BR2_PACKAGE_HOST_LINUX_HEADERS_CUSTOM_4_14=y
BR2_LINUX_KERNEL=y
BR2_LINUX_KERNEL_CUSTOM_TARBALL=y
BR2_LINUX_KERNEL_CUSTOM_TARBALL_LOCATION="$(call github,raspberrypi,linux,6d27aa156c26977dfd079a7107e31670127d17d3)/linux-6d27aa156c26977dfd079a7107e31670127d17d3.tar.gz"
BR2_LINUX_KERNEL_DEFCONFIG="bcm2709"

# Build the DTB from the kernel sources
BR2_LINUX_KERNEL_DTS_SUPPORT=y
BR2_LINUX_KERNEL_INTREE_DTS_NAME="bcm2710-rpi-3-b-plus"

# Required tools to create the SD image
BR2_PACKAGE_HOST_DOSFSTOOLS=y
BR2_PACKAGE_HOST_GENIMAGE=y
BR2_PACKAGE_HOST_MTOOLS=y

# Filesystem / image
BR2_TARGET_ROOTFS_EXT2=y
BR2_TARGET_ROOTFS_EXT2_4=y
BR2_TARGET_ROOTFS_EXT2_SIZE="200M"
BR2_TARGET_ROOTFS_EXT2_MKFS_OPTIONS="-O 64bit"
# BR2_TARGET_ROOTFS_TAR is not set
BR2_ROOTFS_OVERLAY="board/hjdskes/rpi3/rootfs_overlay"
BR2_ROOTFS_POST_IMAGE_SCRIPT="board/hjdskes/rpi3/post-image.sh"

# Packages
BR2_PACKAGE_UTIL_LINUX_AGETTY=y
BR2_PACKAGE_UTIL_LINUX_LOGIN=y
BR2_PACKAGE_SYSTEMD_LOGIND=y
# BR2_PACKAGE_SYSTEMD_HOSTNAMED is not set
# BR2_PACKAGE_SYSTEMD_HWDB is not set
# BR2_PACKAGE_SYSTEMD_TIMEDATED is not set
BR2_PACKAGE_BASH=y
# BR2_PACKAGE_BUSYBOX is not set
BR2_PACKAGE_RPI_FIRMWARE=y
BR2_PACKAGE_RPI_FIRMWARE_INSTALL_DTB_OVERLAYS=y
BR2_PACKAGE_RPI_WIFI_FIRMWARE=y
BR2_PACKAGE_WPA_SUPPLICANT=y
# BR2_PACKAGE_WPA_SUPPLICANT_NL80211 is not set
BR2_PACKAGE_MESA3D=y
BR2_PACKAGE_MESA3D_GALLIUM_DRIVER_VC4=y
BR2_PACKAGE_MESA3D_DRIVER=y
BR2_PACKAGE_MESA3D_OPENGL_ES=y
BR2_PACKAGE_MESA3D_OPENGL_EGL=y
BR2_PACKAGE_CAGE=y
BR2_PACKAGE_LIBGTK3=y
BR2_PACKAGE_LIBGTK3_WAYLAND=y
# BR2_PACKAGE_LIBGTK3_BROADWAY is not set
BR2_PACKAGE_CANTARELL=y
BR2_PACKAGE_ADWAITA_ICON_THEME=y

# Development packages, disable on release build
# BR2_PACKAGE_COREUTILS=y
# BR2_PACKAGE_VIM=y
# BR2_PACKAGE_VIM_RUNTIME is not set
# BR2_PACKAGE_BASH_COMPLETION=y
# BR2_PACKAGE_HTOP=y
# BR2_PACKAGE_PROCPS_NG=y
```

## package/cage/Config.in
```kconfig
config BR2_PACKAGE_CAGE
	bool "Cage"
	select BR2_PACKAGE_WLROOTS
	select BR2_PACKAGE_WAYLAND_PROTOCOLS
	help
	  The Cage Wayland kiosk

	  https://github.com/Hjdskes/cage
```

## package/wlroots/Config.in
```kconfig
comment "wlroots depends on udev"
	depends on !BR2_PACKAGE_HAS_UDEV

config BR2_PACKAGE_WLROOTS
	bool "wlroots"
	depends on BR2_PACKAGE_HAS_UDEV
	select BR2_PACKAGE_WAYLAND
	select BR2_PACKAGE_WAYLAND_PROTOCOLS
	select BR2_PACKAGE_MESA3D_OPENGL_ES # GLESv2 
	select BR2_PACKAGE_LIBDRM
	select BR2_PACKAGE_LIBINPUT
	select BR2_PACKAGE_LIBXKBCOMMON
	# This is required to get wlroots-based compositors to work with keyboards.
	select BR2_PACKAGE_XKEYBOARD_CONFIG
	select BR2_PACKAGE_PIXMAN
	select BR2_PACKAGE_WLROOTS_LOGIND if BR2_PACKAGE_SYSTEMD_LOGIND
	help
	  The modular Wayland compositor library

	  https://github.com/swaywm/wlroots

if BR2_PACKAGE_WLROOTS

# Uses libgbm from mesa3d and requires OpenGL EGL
comment "wlroots needs an OpenGL EGL backend provided by mesa3d"
	depends on !BR2_PACKAGE_MESA3D_OPENGL_EGL

config BR2_PACKAGE_WLROOTS_LIBCAP
	bool "enable capability support"
	help
	  this enables support for rootless session via capabilities (cap_sys_admin)

if BR2_PACKAGE_SYSTEMD_LOGIND

config BR2_PACKAGE_WLROOTS_LOGIND
	bool "enable logind support"
	help 
	  this enables support for rootless session via logind 

endif

# TODO: finish this
# config BR2_PACKAGE_WLROOTS_X11
#	bool "X11 compositor"
#	depends on BR2_PACKAGE_XORG7
#	select BR2_PACKAGE_LIBXCB
#	select BR2_PACKAGE_XLIB_LIBX11
#
# config BR2_PACKAGE_WLROOTD_XWAYLAND
#	bool "Xwayland support"
#	depends on BR2_PACKAGE_XORG7
#	depends on BR2_PACKAGE_LIBXCB
#	select BR2_PACKAGE_XLIB_LIBX11
#	select BR2_PACKAGE_XLIB_LIBXCURSOR

endif
```
